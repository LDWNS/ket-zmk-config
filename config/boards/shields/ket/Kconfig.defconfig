## config/boards/shields/ket/Kconfig.defconfig
```kconfig
if SHIELD_KET_LEFT

# Name must be less than 16 characters long!
config ZMK_KET
    default "ket"

config ZMK_SPLIT_ROLE_CENTRAL
    default y

endif

if SHIELD_KET_LEFT || SHIELD_KET_RIGHT

config ZMK_SPLIT
    default y

endif
```
